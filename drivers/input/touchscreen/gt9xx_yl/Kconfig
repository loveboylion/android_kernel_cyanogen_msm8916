## drivers/input/touchscreen/gt9xx_yl/Kconfig
```kconfig
#
# Yulong Goodix GT9xx Touchscreen driver
#

config TOUCHSCREEN_GT9XX_YL_COVER_WINDOW_SIZE
	bool "Touchscreen cover window size"
	depends on TOUCHSCREEN_GT9XX_YL
	help
	  Say Y here if you want to set a size for cover window.
	  This is used for the IC that cann't support window mode in firmware.
	  So you can set a window size in your driver.

	  If unsure, say N.

config TOUCHSCREEN_GT9XX_YL_COVER_WINDOW_CFG
	bool "Touchscreen cover window config switch"
	depends on TOUCHSCREEN_GT9XX_YL
	help
	  Say Y here if you want to set conver window mode via switching a config file.
	  This is used for the IC(goodix) that can support window mode in firmware.
	  So you can set a window mode via a config.

	  If unsure, say N.

config TOUCHSCREEN_GT9XX_YL_TW_GLOVE_SWITCH
	bool "Touchscreen glove window switch"
	depends on TOUCHSCREEN_GT9XX_YL
	help
	  Say Y here if you want to set conver window mode.
	  This is used for the IC(syna) that cannt't support window mode in firmware.
	  So you can set a window mode in your driver.

	  If unsure, say N.

 config TOUCHSCREEN_GT9XX_YL_DRIVER
	tristate "Goodix GT9xx touchpanel (Yulong variant) driver"
	depends on TOUCHSCREEN_GT9XX_YL
	default n
	help
	  This is the main file for touchpanel driver for Goodix GT9xx
	  touchscreens.

 	  Say Y here if you have a Goodix GT9xx touchscreen connected
	  to your system.

 	  If unsure, say N.

 	  To compile this driver as a module, choose M here: the
	  module will be called gt9xx.

 config TOUCHSCREEN_GT9XX_YL_UPDATE
	tristate "Goodix GT9xx touchpanel (Yulong variang) auto update support"
	depends on TOUCHSCREEN_GT9XX_YL_DRIVER
	default n
	help
	  This enables support for firmware update for Goodix GT9xx
	  touchscreens.

 	  Say Y here if you have a Goodix GT9xx touchscreen connected
	  to your system.

 	  If unsure, say N.

 	  To compile this driver as a module, choose M here: the
	  module will be called gt9xx_update.

 config TOUCHSCREEN_GT9XX_YL_DEBUG
	tristate "Goodix GT9xx (Yulong variang) Tools for debuging"
	depends on TOUCHSCREEN_GT9XX_YL_DRIVER
	default n
	help
	  This is application debug interface support for Goodix GT9xx
	  touchscreens.

 	  Say Y here if you want to have a Android app debug interface
	  to your system.

 	  If unsure, say N.

 	  To compile this driver as a module, choose M here: the
	  module will be called goodix_tool.
```
